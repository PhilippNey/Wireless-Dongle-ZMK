## boards/shields/sofle_choc_pro_dongle/Kconfig.defconfig
```kconfig
if SHIELD_SOFLE_CHOC_PRO_DONGLE

config ZMK_KEYBOARD_NAME
    default "Sofle Dongle"

config ZMK_SPLIT_ROLE_CENTRAL
    default y

config ZMK_SPLIT
    default y

# Zwei Peripherals: linke und rechte Hälfte
config ZMK_SPLIT_BLE_CENTRAL_PERIPHERALS
    default 2

# Peripherals + 5 Bluetooth-Profile
config BT_MAX_CONN
    default 7

config BT_MAX_PAIRED
    default 7

endif
```

## config/west.yml
```yaml
manifest:
  remotes:
    - name: zmkfirmware
      url-base: https://github.com/zmkfirmware
    - name: splitkb
      url-base: https://github.com/splitkb
  projects:
    - name: zmk
      remote: splitkb
      revision: v0.3-branch+halcyon-fixes
      import: app/west.yml
    - name: zmk-halcyon-module
      remote: splitkb
      revision: v0.3-branch
  self:
    path: config
```
